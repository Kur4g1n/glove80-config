## module/Kconfig
```kconfig
config PERSONAL_GLOVE80
    bool "Immediate Glove80 layers and dual Shift"
    default y
    depends on ZMK_RGB_UNDERGLOW && EXPERIMENTAL_RGB_LAYER
```

## module/dts/bindings/behaviors/personal,layer.yaml
```yaml
description: Immediate momentary layer with independent double-tap and Magic locking
compatible: "personal,layer"
include: one_param.yaml
```

## module/dts/bindings/behaviors/personal,lock-color.yaml
```yaml
description: Layer switch color, red when its layer is locked
compatible: "personal,lock-color"
include: two_param.yaml
properties:
  locked-color:
    type: int
    required: true
    description: RGB color of a locked layer switch, generated from the shared palette
```

## module/dts/bindings/behaviors/personal,lock-state.yaml
```yaml
description: Synchronize the locked layer to both halves for RGB rendering
compatible: "personal,lock-state"
include: one_param.yaml
```

## module/dts/bindings/behaviors/personal,magic.yaml
```yaml
description: Immediate Magic layer and status on unused tap
compatible: "personal,magic"
include: zero_param.yaml
```

## module/dts/bindings/behaviors/personal,palette-color.yaml
```yaml
description: Selected firmware palette color, including the locked layer indicator
compatible: "personal,palette-color"
include: two_param.yaml
properties:
  theme-count:
    type: int
    required: true
    description: Number of selected palettes in effect-cycle order
  colors:
    type: array
    required: true
    description: Each palette contains five maps of 80 RGB colors followed by its lock color
```

## module/dts/bindings/behaviors/personal,shift.yaml
```yaml
description: Immediate Shift with unbuffered dual-Shift Caps Lock
compatible: "personal,shift"
include: one_param.yaml
```
